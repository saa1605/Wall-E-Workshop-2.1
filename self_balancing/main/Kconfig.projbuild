## self_balancing/main/Kconfig.projbuild
```kconfig
menu "Wifi Configuration"

config WIFI_SSID
    string "WiFi SSID"
    default "SSID"
    help
	SSID (network name) for the example to connect to.

config WIFI_PASS
    string "WiFi Password"
    default "PASSWORD"
    help
	WiFi password (WPA or WPA2) for the example to use.

endmenu
```
